## uboot-mtk-20250711/configs/mt7981_tplink_wma301v2_custom_defconfig
```kconfig
CONFIG_ARM=y
CONFIG_SYS_HAS_NONCACHED_MEMORY=y
CONFIG_POSITION_INDEPENDENT=y
CONFIG_ARCH_MEDIATEK=y
CONFIG_TEXT_BASE=0x41e00000
CONFIG_SYS_MALLOC_F_LEN=0x4000
CONFIG_NR_DRAM_BANKS=1
CONFIG_ENV_SIZE=0x1f000
CONFIG_DEFAULT_DEVICE_TREE="mt7981-tplink-wma301v2-custom"
CONFIG_SYS_PROMPT="WMA301> "
CONFIG_TARGET_MT7981=y
CONFIG_DEBUG_UART_BASE=0x11002000
CONFIG_DEBUG_UART_CLOCK=40000000
CONFIG_SYS_LOAD_ADDR=0x46000000
CONFIG_DEBUG_UART=y
CONFIG_MEDIATEK_BOOTMENU=y
CONFIG_MEDIATEK_BOOTMENU_DELAY=3
CONFIG_MTK_WEB_FAILSAFE=y
CONFIG_MTK_WEB_FAILSAFE_AFTER_BOOT_FAILURE=y
CONFIG_MTK_UBI_SUPPORT=y
# CONFIG_MTK_UPGRADE_BL2_VERIFY is not set
# CONFIG_MTK_UPGRADE_IMAGE_VERIFY is not set
CONFIG_FIT=y
CONFIG_AUTOBOOT_MENU_SHOW=y
CONFIG_AUTOBOOT_MENU_MTK_SHOW=y
CONFIG_DEFAULT_FDT_FILE="mt7981-tplink-wma301v2-custom"
CONFIG_LOGLEVEL=7
CONFIG_LOG=y
CONFIG_HUSH_PARSER=y
CONFIG_SYS_CBSIZE=512
CONFIG_SYS_PBSIZE=1049
# CONFIG_BOOTM_NETBSD is not set
# CONFIG_BOOTM_PLAN9 is not set
# CONFIG_BOOTM_RTEMS is not set
# CONFIG_BOOTM_VXWORKS is not set
# CONFIG_CMD_ELF is not set
CONFIG_CMD_MEMINFO=y
# CONFIG_CMD_UNLZ4 is not set
# CONFIG_CMD_UNZIP is not set
CONFIG_CMD_GPIO=y
CONFIG_CMD_GPIO_READ=y
CONFIG_CMD_PWM=y
CONFIG_CMD_MTD=y
CONFIG_CMD_TFTPPUT=y
CONFIG_CMD_PING=y
CONFIG_CMD_SMC=y
CONFIG_CMD_MTDPARTS=y
CONFIG_MTDIDS_DEFAULT="spi-nand0=spi-nand0"
CONFIG_MTDPARTS_DEFAULT="spi-nand0:128k(bl2)ro,3712k(fip)ro,256k(reserved)ro,512k(factory_info)ro,512k(art)ro,2048k(config)ro,-(ubi)"
CONFIG_CMD_GL_BTN=y
CONFIG_OF_EMBED=y
CONFIG_ENV_OVERWRITE=y
# CONFIG_ENV_IS_IN_MTD is not set
CONFIG_ENV_VARS_UBOOT_RUNTIME_CONFIG=y
CONFIG_NET_RANDOM_ETHADDR=y
CONFIG_USE_IPADDR=y
CONFIG_IPADDR="192.168.1.1"
CONFIG_USE_NETMASK=y
CONFIG_NETMASK="255.255.255.0"
CONFIG_USE_SERVERIP=y
CONFIG_SERVERIP="192.168.1.2"
CONFIG_PROT_TCP=y
CONFIG_REGMAP=y
CONFIG_SYSCON=y
CONFIG_BUTTON=y
CONFIG_BUTTON_GPIO=y
CONFIG_CLK=y
# CONFIG_I2C is not set
CONFIG_LED=y
CONFIG_LED_BLINK=y
CONFIG_LED_GPIO=y
# CONFIG_MMC is not set
CONFIG_DM_MTD=y
CONFIG_MTD_SPI_NAND=y
CONFIG_PHY_FIXED=y
CONFIG_MEDIATEK_ETH=y
CONFIG_PINCTRL=y
CONFIG_PINCONF=y
CONFIG_PINCTRL_MT7981=y
CONFIG_POWER_DOMAIN=y
CONFIG_MTK_POWER_DOMAIN=y
CONFIG_DM_REGULATOR=y
CONFIG_DM_REGULATOR_FIXED=y
CONFIG_DM_REGULATOR_GPIO=y
CONFIG_DM_PWM=y
CONFIG_PWM_MTK=y
CONFIG_DM_SERIAL=y
CONFIG_MTK_SERIAL=y
CONFIG_SPI=y
CONFIG_DM_SPI=y
CONFIG_MTK_SPIM=y
CONFIG_TIMER=y
CONFIG_MTK_TIMER=y
CONFIG_HEXDUMP=y
CONFIG_MD5=y
# CONFIG_CMD_XIMG is not set
CONFIG_CMD_BOOTMENU=y
# CONFIG_DM_I2C is not set
# CONFIG_I2C_SET_DEFAULT_BUS_NUM is not set
# CONFIG_PCIE_MEDIATEK is not set
# CONFIG_EFI_LOADER is not set
# CONFIG_ENABLE_NAND_NMBM is not set
# CONFIG_MEDIATEK_MULTI_MTD_LAYOUT is not set
# CONFIG_MTK_DUAL_BOOT is not set
CONFIG_MTK_FIXED_MTD_MTDPARTS=y
CONFIG_CMD_UBI=y
CONFIG_MTK_UBI_RESERVED_VOLUMES="ubootenv=124k;ubootenv2=124k"
# CONFIG_MTK_UPGRADE_FIP_VERIFY is not set
# CONFIG_ENV_IS_NOWHERE is not set
CONFIG_ENV_IS_IN_UBI=y
CONFIG_ENV_REDUNDANT=y
CONFIG_ENV_UBI_PART="ubi"
CONFIG_ENV_UBI_VOLUME="ubootenv"
CONFIG_ENV_UBI_VOLUME_REDUND="ubootenv2"
CONFIG_ENV_UBI_VOLUME_CREATE=y
CONFIG_CMD_SAVEENV=y
CONFIG_WEBUI_FAILSAFE=y
CONFIG_WEBUI_FAILSAFE_UI_WMA301=y
CONFIG_WEBUI_FAILSAFE_BUILD_VARIANT="wma301-custom"
CONFIG_WEBUI_FAILSAFE_ADVANCED=y
CONFIG_WEBUI_FAILSAFE_BACKUP=y
# CONFIG_WEBUI_FAILSAFE_FLASH is not set
# CONFIG_WEBUI_FAILSAFE_NAND_RAW is not set
CONFIG_WEBUI_FAILSAFE_CONSOLE=y
CONFIG_WEBUI_FAILSAFE_ENV=y
CONFIG_WEBUI_FAILSAFE_ENV_DEFAULT_GLBTN_KEY=y
# CONFIG_WEBUI_FAILSAFE_FACTORY is not set
# CONFIG_WEBUI_FAILSAFE_SIMG is not set
CONFIG_WEBUI_FAILSAFE_UBI=y
CONFIG_MTK_DHCPD=y
CONFIG_MTK_UPGRADE_FW_ONLY=y
CONFIG_GLBTN_DEFAULT_KEYS="reset,mesh"
CONFIG_MTK_UPGRADE_OEM_FIP_BL33=y
CONFIG_MTK_UPGRADE_OEM_FIP_BL33_BOARD="tplink,wma301-v2"
CONFIG_MTK_MAC_FROM_MTD=y
CONFIG_MTK_MAC_MTD_PART="factory_info"
CONFIG_MTK_MAC_MTD_OFFSET=0x1c
CONFIG_BOARD_LATE_INIT=y
CONFIG_XZ=y
```
